## meta-yocto-chromebook/conf/layer.conf
```bitbake
# Yocto Chromebook layer configuration

BBPATH .= ":${LAYERDIR}"

BBFILES += "\
    ${LAYERDIR}/recipes-*/*/*.bb \
    ${LAYERDIR}/recipes-*/*/*.bbappend \
"

BBFILE_COLLECTIONS += "yoctochromebook"
BBFILE_PATTERN_yoctochromebook = "^${LAYERDIR}/"
BBFILE_PRIORITY_yoctochromebook = "6"

# Keep the first POC pinned to a stable Yocto LTS branch until later
# milestones deliberately qualify another series.
LAYERSERIES_COMPAT_yoctochromebook = "scarthgap"
```
